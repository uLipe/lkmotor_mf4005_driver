## Kconfig
```kconfig
# Copyright (c) 2024 Felipe Neves
# SPDX-License-Identifier: Apache-2.0

config LKMOTOR_MF4005_DRIVER
    bool "Enable MF4005 brushless motor driver"
    help
      Enables Zephyr out of tree MF4005 brushless motor driver

if LKMOTOR_MF4005_DRIVER

config MF4005_ENABLE_AT_BOOT
    bool "Enable the brushless motor at startup"
    help
      Enable the brushless motor at startup

config MF4005_DRIVER_SHELL
    bool "Enable MF4005 motor shell commands"
    select SHELL

endif #LKMOTOR_MF4005_DRIVER
```

## dts/bindings/lkm-mf4005.yml
```yaml
# Copyright (c) 2024 Felipe Neves
# SPDX-License-Identifier: Apache-2.0

description: |
  MF4005 Motor Brushless over CAN driver. Example usage:

    &fdcan1 {
      bus-speed = <1000000>;
      status = "okay";
      
      # address-cells = <1>;
      # size-cells = <0>;	
      mf4005_motor: mf4005_motor@140 {
        compatible = "lkm,mf4005";
        reg = <0x140>;
        max-current-ma = <240>;
        encoder-resolution-bits = <16>;
        max-speed-dps = <12000>;
      };
    };

compatible: "lkm,mf4005"

properties:
  max-current-ma: 
    required: true
    type: int
    description: |
      Max current supported to the motor in milliamperes
  
  encoder-resolution-bits: 
    required: true
    type: int
    description: |
      Resolution of the motor encoder sensor
    
  max-speed-dps: 
    required: true
    type: int
    description: |
      Maximum rotation speed in degrees per second

include: [base.yaml, can-controller.yaml]
```
